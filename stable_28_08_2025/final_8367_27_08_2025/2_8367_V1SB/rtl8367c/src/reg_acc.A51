; .\reg_acc.SRC generated from: reg_acc.c
; COMPILER INVOKED BY:
;        C:\Keil\C51\BIN\C51.EXE reg_acc.c OMF2 BROWSE DEFINE(RTL8370Ss) DEBUG SRC(.\reg_acc.SRC)

$NOMOD51

NAME	REG_ACC

TB81	BIT	0C0H.3
P0	DATA	080H
P1	DATA	090H
SM01	BIT	0C0H.7
P2	DATA	0A0H
SM11	BIT	0C0H.6
P3	DATA	0B0H
SM21	BIT	0C0H.5
T0	BIT	0B0H.4
AC	BIT	0D0H.6
T1	BIT	0B0H.5
T2	BIT	090H.0
EA	BIT	0A8H.7
DPH1	DATA	085H
IE	DATA	0A8H
FL	BIT	0D0H.1
DPL1	DATA	084H
TA	DATA	0C7H
EXF2	BIT	0C8H.6
RD	BIT	0B0H.7
REN1	BIT	0C0H.4
IP	DATA	0B8H
INDACC_RDATA_H	DATA	0A6H
RI	BIT	098H.0
INT0	BIT	0B0H.2
CY	BIT	0D0H.7
TI	BIT	098H.1
INT1	BIT	0B0H.3
SADEN0	DATA	0B9H
INT2	BIT	090H.4
SADEN1	DATA	0BAH
INDACC_RDATA_L	DATA	0A7H
RXD0	BIT	0B0H.0
INT3	BIT	090H.5
INDACC_WDATA_H	DATA	0A4H
RXD1	BIT	090H.2
INT4	BIT	090H.6
SADDR0	DATA	0A9H
TXD0	BIT	0B0H.1
INT5	BIT	090H.7
SADDR1	DATA	0AAH
TXD1	BIT	090H.3
RCAP2H	DATA	0CBH
SP	DATA	081H
INDACC_WDATA_L	DATA	0A5H
T2EX	BIT	090H.1
EPFI	BIT	0D8H.5
OV	BIT	0D0H.2
RCAP2L	DATA	0CAH
C_T2	BIT	0C8H.1
WR	BIT	0B0H.6
EWDI	BIT	0E8H.4
WDIF	BIT	0D8H.3
RCLK	BIT	0C8H.5
EXIF	DATA	091H
TCLK	BIT	0C8H.4
PCON	DATA	087H
FLASH_MSB	DATA	096H
PWDI	BIT	0F8H.4
TMOD	DATA	089H
TCON	DATA	088H
IE0	BIT	088H.1
IE1	BIT	088H.3
B	DATA	0F0H
WTRF	BIT	0D8H.2
CP_RL2	BIT	0C8H.0
SMOD_1	BIT	0D8H.7
ACC	DATA	0E0H
ES0	BIT	0A8H.4
INDACC_ADDR_H	DATA	0A2H
ET0	BIT	0A8H.1
ES1	BIT	0A8H.6
ET1	BIT	0A8H.3
TF0	BIT	088H.5
ET2	BIT	0A8H.5
TF1	BIT	088H.7
TF2	BIT	0C8H.7
RI1	BIT	0C0H.0
RB8	BIT	098H.2
TH0	DATA	08CH
INDACC_ADDR_L	DATA	0A3H
EX0	BIT	0A8H.0
IT0	BIT	088H.0
TH1	DATA	08DH
TI1	BIT	0C0H.1
TB8	BIT	098H.3
EX1	BIT	0A8H.2
IT1	BIT	088H.2
TH2	DATA	0CDH
EX2	BIT	0E8H.0
P	BIT	0D0H.0
EX3	BIT	0E8H.1
SM0	BIT	098H.7
TL0	DATA	08AH
EX4	BIT	0E8H.2
SM1	BIT	098H.6
TL1	DATA	08BH
EX5	BIT	0E8H.3
SM2	BIT	098H.5
TL2	DATA	0CCH
PS0	BIT	0B8H.4
EIE	DATA	0E8H
PT0	BIT	0B8H.1
PS1	BIT	0B8H.6
SYNC_CTRL	DATA	08EH
GPIO_E	DATA	093H
PT1	BIT	0B8H.3
RS0	BIT	0D0H.3
PT2	BIT	0B8H.5
TR0	BIT	088H.4
RS1	BIT	0D0H.4
TR1	BIT	088H.6
TR2	BIT	0C8H.2
PX0	BIT	0B8H.0
INDACC_CMD	DATA	0A0H
GPIO_I	DATA	095H
PX1	BIT	0B8H.2
PX2	BIT	0F8H.0
PX3	BIT	0F8H.1
PX4	BIT	0F8H.2
DPH	DATA	083H
PX5	BIT	0F8H.3
EIP	DATA	0F8H
GPIO_O	DATA	094H
PFI	BIT	0D8H.4
DPL	DATA	082H
SBUF0	DATA	099H
SBUF1	DATA	0C1H
EXEN2	BIT	0C8H.3
SCON0	DATA	098H
REN	BIT	098H.4
SCON1	DATA	0C0H
STATUS	DATA	0C5H
T2MOD	DATA	0C9H
T2CON	DATA	0C8H
DPS	DATA	086H
INDACC_STATUS	DATA	0A1H
CKCON	DATA	08EH
EWT	BIT	0D8H.1
POR	BIT	0D8H.6
F0	BIT	0D0H.5
PSW	DATA	0D0H
WDCON	DATA	0D8H
RWT	BIT	0D8H.0
RB81	BIT	0C0H.2
?PR?_getReg?REG_ACC  SEGMENT CODE 
?PR?_setReg?REG_ACC  SEGMENT CODE 
?DT?_setReg?REG_ACC  SEGMENT DATA OVERLAYABLE
	PUBLIC	_setReg
	PUBLIC	_getReg

	RSEG  ?DT?_setReg?REG_ACC
?_setReg?BYTE:
        tmp?144:   DS   2
; #include "rtl_types.h"
; #include "reg320.h"
; 
; uint16 getReg(uint16 address)

	RSEG  ?PR?_getReg?REG_ACC
_getReg:
	USING	0
			; SOURCE LINE # 4
;---- Variable 'address?040' assigned to Register 'R4/R5' ----
  CLR   EA
	MOV  	R5,AR7
	MOV  	R4,AR6
; {
			; SOURCE LINE # 5
; 	uint16 tmp;
; 	
;     INDACC_ADDR_H = address / 0x100;
			; SOURCE LINE # 8
	MOV  	INDACC_ADDR_H,R4
;     INDACC_ADDR_L = address & 0xFF;
			; SOURCE LINE # 9

  MOV  	INDACC_ADDR_L,R5

; 	INDACC_CMD = 0x01;
			; SOURCE LINE # 10
	MOV  	INDACC_CMD,#01H
?C0001:
  NOP
  NOP
  NOP
  NOP
  NOP
  NOP
  NOP
  NOP
  NOP
  NOP
  NOP
; 
;     while(INDACC_STATUS);
			; SOURCE LINE # 12
	MOV  	R6,INDACC_STATUS
	CJNE  R6,#0,?C0001
?C0002:
; 
; 	tmp = (uint16)((uint16)(INDACC_RDATA_H) << ((uint16)8)) | (uint16)INDACC_RDATA_L;
			; SOURCE LINE # 14
	MOV  	R6,INDACC_RDATA_H
	MOV  	R7,INDACC_RDATA_L
;---- Variable 'tmp?041' assigned to Register 'R6/R7' ----
; 	return tmp;
			; SOURCE LINE # 15
; }
			; SOURCE LINE # 16
?C0003:
  SETB  EA
	RET  	
; END OF _getReg

; 
; void setReg(uint16 address, uint16 value)

	RSEG  ?PR?_setReg?REG_ACC
_setReg:
	USING	0
			; SOURCE LINE # 18
;---- Variable 'value?143' assigned to Register 'R4/R5' ----
;---- Variable 'address?142' assigned to Register 'R2/R3' ----
  CLR   EA
	MOV  	R3,AR7
	MOV  	R2,AR6
; {
			; SOURCE LINE # 19
;     uint16 tmp = 0;
			; SOURCE LINE # 20
; 
;     INDACC_ADDR_H = (uint8)(address / 0x100);
			; SOURCE LINE # 22
	MOV  	INDACC_ADDR_H,R2
;     INDACC_ADDR_L = (uint8)(address & 0xFF);
			; SOURCE LINE # 23
	MOV  	INDACC_ADDR_L,R3
;     INDACC_WDATA_H = (uint8)(value / 0x100);
			; SOURCE LINE # 24
	MOV  	INDACC_WDATA_H,R4
;     INDACC_WDATA_L = (uint8)(value & 0xFF);
			; SOURCE LINE # 25
	MOV  	INDACC_WDATA_L,R5
	MOV  	INDACC_CMD,#03H
?C0004:
;     while(INDACC_STATUS);
  NOP
  NOP
  NOP
			; SOURCE LINE # 26
	MOV  	R2,INDACC_STATUS
	CJNE  R2,#0,?C0004
?C0005:
; 
;     INDACC_CMD = 0x03;
			; SOURCE LINE # 28
	
; 		
; 	return;
; }
			; SOURCE LINE # 31
?C0006:
  SETB  EA
	RET  	
; END OF _setReg

	END
